## conf/layer.conf
```bitbake
# We have a conf and classes directory, add to BBPATH
BBPATH .= ":${LAYERDIR}"

# We have recipes-* directories, add to BBFILES
BBFILES += "${LAYERDIR}/recipes-*/*/*.bb ${LAYERDIR}/recipes-*/*/*.bbappend"

BBFILE_COLLECTIONS += "tss-example"
BBFILE_PATTERN_tss-example = "^${LAYERDIR}/"
BBFILE_PRIORITY_tss-example = "1"

# This should only be incremented on significant changes that will
# cause compatibility issues with other layers
LAYERVERSION_tss-example = "1"

LAYERDEPENDS_tss-example = "core"

LAYERSERIES_COMPAT_tss-example = "mickledore"
```
